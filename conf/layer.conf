## conf/layer.conf
```bitbake
# We have a conf and classes directory, add to BBPATH
BBPATH =. "${LAYERDIR}:"

# We have a recipe-* directory, add to BBFILES
BBFILES += "${LAYERDIR}/recipes-*/*/*.bb \
            ${LAYERDIR}/recipes-*/*/*.bbappend"

BBFILE_COLLECTIONS += "local"
BBFILE_PATTERN_local = "^${LAYERDIR}/"
BBFILE_PRIORITY_local = "1000"

# Add scripts to PATH
PATH .= ":${LAYERDIR}/scripts"

# Allow the developer to put pre-downloaded src into the downloads directory
# Also allow the user to have bare clones of repositories in the git directory
PREMIRRORS_append = "\
     .*://.*/.* file://${LAYERDIR}/downloads/ \n \
     git://.*/.* git://${LAYERDIR}/git/BASENAME;protocol=file \n \
"

# Enable the local layer unconditionally if the whitelist in enabled
PNWHITELIST_LAYERS_remove = "local"

LAYERSERIES_COMPAT_local = "sumo"

# WLP
CORE_IMAGE_EXTRA_INSTALL += "perf qemu procps util-linux kernel-modules"
PREFERRED_PROVIDER_virtual/kernel = "linux-yocto-dev"
DISTRO_FEATURES_append = " virtualization kvm"
KERNEL_FEATURES_append = " \
    features/full_nohz/full_nohz-enable.scc \
"
KERNEL_MODULE_AUTOLOAD_pn-linux-yocto-dev += "kvm-intel"
```
